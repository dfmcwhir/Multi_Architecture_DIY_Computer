; generated by gen.py
PIC_WILLY    = 0
PIC_ROBOT    = 4
PIC_BIRD     = 6
PIC_BLOB     = 8
PIC_SPIN     = 10
PIC_SKULL    = 12
PIC_JELLY    = 14
PIC_PORTAL   = 16
NPIC        = 19
SPR_DEFS    = 420          ; 304 bytes of the pool
spr_defs:
        .byte   $1C, $08, $1C, $01, $00, $06, $08, $01, $70, $F8, $50, $70, $F8, $30, $30, $48
        .byte   $70, $F8, $70, $70, $F8, $30, $30, $78, $1C, $01, $01, $06, $08, $01, $70, $F8
        .byte   $50, $70, $78, $B0, $50, $88, $70, $F8, $70, $70, $78, $F0, $70, $F8, $1C, $01
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        .byte   $FF, $FF, $FF, $FF
guard_pic:  ; the first picture of each kind of guardian
        .byte   PIC_ROBOT, PIC_BIRD, PIC_BLOB, PIC_SPIN, PIC_SKULL, PIC_JELLY
tile_l: .byte   $00, $07, $F7, $1B, $27, $0B, $09, $01, $BA, $A6
tile_r: .byte   $00, $07, $BF, $1B, $27, $0A, $02, $04, $E8, $19
JTAB_LEN    = 16
jtab:   .byte   $FD, $FE, $FE, $FE, $FF, $FF, $FF, $00, $00, $01, $01, $01, $02, $02, $02, $03
NROOM       = 8
room_lo: .byte  <room0, <room1, <room2, <room3, <room4, <room5, <room6, <room7
room_hi: .byte  >room0, >room1, >room2, >room3, >room4, >room5, >room6, >room7
; each room: its name (32 characters), air, Willy x, y, the portal x, y,
; the number of guardians and 7 bytes each (kind, axis 0 across / 1 up and
; down, x, y, low, high, slow; in pixels), then the 40 x 20 tiles, two to
; a byte (the first in the low 4 bits)
room0:  .byte   "        THE BOOT SECTOR         "
        .byte   120, 8, 68, 136, 68, 2
        .byte   0, 0, 24, 68, 20, 104, 0, 1, 0, 48, 4, 40, 88, 1
        .byte   $22, $22, $22, $22, $22, $22, $22, $22, $22, $22, $22, $22, $22, $22, $22, $22, $22, $22, $22, $22
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        .byte   $12, $11, $11, $11, $11, $11, $11, $11, $11, $11, $11, $11, $11, $11, $11, $11, $11, $11, $11, $21
room1:  .byte   "         STACK OVERFLOW         "
        .byte   120, 8, 68, 72, 68, 3
        .byte   1, 0, 52, 8, 48, 100, 0, 0, 0, 80, 68, 24, 136, 1, 3, 1, 80, 44, 44, 56, 0
        .byte   $22, $22, $22, $22, $22, $22, $22, $22, $22, $22, $22, $22, $22, $22, $22, $22, $22, $22, $22, $22
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        .byte   $12, $11, $11, $11, $11, $11, $11, $11, $11, $11, $11, $11, $11, $11, $11, $11, $11, $11, $11, $21
room2:  .byte   "           ZERO PAGE            "
        .byte   120, 8, 68, 140, 68, 3
        .byte   3, 1, 52, 32, 32, 48, 0, 4, 0, 16, 68, 8, 128, 1, 0, 0, 80, 16, 76, 108, 0
        .byte   $22, $22, $22, $22, $22, $22, $22, $22, $22, $22, $22, $22, $22, $22, $22, $22, $22, $22, $22, $22
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        .byte   $12, $11, $11, $11, $11, $11, $11, $11, $11, $11, $11, $11, $11, $11, $11, $11, $11, $11, $11, $21
room3:  .byte   "      THE INTERRUPT VECTOR      "
        .byte   120, 8, 68, 144, 68, 4
        .byte   5, 1, 24, 24, 24, 40, 0, 1, 0, 60, 4, 56, 120, 1, 2, 0, 48, 68, 28, 60, 0, 0, 0, 104, 68, 100, 136, 0
        .byte   $22, $22, $22, $22, $22, $22, $22, $22, $22, $22, $22, $22, $22, $22, $22, $22, $22, $22, $22, $22
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        .byte   $12, $11, $11, $11, $11, $11, $11, $11, $11, $00, $00, $00, $11, $11, $11, $11, $11, $11, $11, $21
room4:  .byte   "         BUS CONTENTION         "
        .byte   120, 8, 68, 144, 68, 4
        .byte   1, 0, 24, 4, 20, 116, 0, 3, 1, 64, 16, 12, 36, 1, 4, 0, 52, 44, 52, 100, 1, 0, 0, 80, 68, 24, 136, 0
        .byte   $22, $22, $22, $22, $22, $22, $22, $22, $22, $22, $22, $22, $22, $22, $22, $22, $22, $22, $22, $22
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        .byte   $12, $11, $11, $11, $11, $11, $11, $11, $11, $11, $11, $11, $11, $11, $11, $11, $11, $11, $11, $21
room5:  .byte   "          DECIMAL MODE          "
        .byte   120, 8, 68, 148, 68, 4
        .byte   2, 0, 16, 20, 16, 44, 0, 2, 0, 88, 20, 88, 108, 0, 5, 1, 72, 28, 28, 52, 1, 0, 0, 24, 68, 20, 132, 0
        .byte   $22, $22, $22, $22, $22, $22, $22, $22, $22, $22, $22, $22, $22, $22, $22, $22, $22, $22, $22, $22
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        .byte   $12, $11, $11, $11, $11, $11, $11, $11, $11, $11, $11, $11, $11, $11, $11, $11, $11, $11, $11, $21
room6:  .byte   "      THE ILLEGAL OPCODES       "
        .byte   120, 8, 68, 132, 68, 3
        .byte   1, 0, 24, 4, 20, 128, 0, 4, 0, 48, 20, 48, 100, 1, 0, 0, 64, 68, 24, 104, 0
        .byte   $22, $22, $22, $22, $22, $22, $22, $22, $22, $22, $22, $22, $22, $22, $22, $22, $22, $22, $22, $22
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        .byte   $12, $11, $11, $11, $11, $11, $11, $11, $11, $11, $11, $11, $11, $11, $11, $11, $11, $11, $11, $21
room7:  .byte   "        THE RESET VECTOR        "
        .byte   150, 8, 68, 140, 68, 5
        .byte   1, 0, 24, 12, 24, 120, 0, 5, 1, 64, 24, 20, 44, 0, 5, 1, 92, 24, 20, 44, 1, 2, 0, 48, 68, 44, 88, 0, 0, 0, 104, 68, 100, 140, 1
        .byte   $22, $22, $22, $22, $22, $22, $22, $22, $22, $22, $22, $22, $22, $22, $22, $22, $22, $22, $22, $22
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        .byte   $12, $11, $11, $11, $11, $11, $11, $11, $11, $11, $11, $11, $11, $11, $11, $11, $11, $11, $11, $21
